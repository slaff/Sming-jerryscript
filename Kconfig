## Kconfig
```kconfig
menu "JerryScript"
    config JERRY_GLOBAL_HEAP_SIZE
        int "The size in kilobytes of the internal JerryScript heap"
        default 1

    config JERRY_COMPACT_PROFILE
    	bool "Use compact profile"
        default Y
        help
            No built-ins, no ES.next or unicode case conversion support.

    config JERRY_ENABLE_DEBUG
        bool "Enable assertions and debug messages in jerryscript library"
        default N
        help
            Should be left disabled unless debugging the jerryscript engine itself.

    config JERRY_MEM_STATS
        bool "Enable jerryscript heap memory tracking"
        default Y

    config JERRY_ERROR_MESSAGES
        bool "Enable text messages for common errors"
        default N
        help
            Consumes ~2K RAM on ESP8266

endmenu
```
